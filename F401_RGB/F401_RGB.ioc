# file: F401_RGB.ioc
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Dma.Request0=TIM4_CH2
Dma.Request1=TIM4_UP
Dma.TIM4_CH2.0.Direction=DMA_MEMORY_TO_PERIPH
Dma.TIM4_CH2.0.FIFOMode=DMA_FIFOMODE_DISABLE
Dma.TIM4_CH2.0.Instance=DMA1_Stream3
Dma.TIM4_CH2.0.MemDataAlignment=DMA_MDATAALIGN_WORD
Dma.TIM4_CH2.0.MemInc=DMA_MINC_ENABLE
Dma.TIM4_CH2.0.Mode=DMA_NORMAL
Dma.TIM4_CH2.0.PeriphDataAlignment=DMA_PDATAALIGN_WORD
Dma.TIM4_CH2.0.PeriphInc=DMA_PINC_DISABLE
Dma.TIM4_CH2.0.Priority=DMA_PRIORITY_VERY_HIGH
Dma.TIM4_UP.1.Direction=DMA_MEMORY_TO_PERIPH
Dma.TIM4_UP.1.FIFOMode=DMA_FIFOMODE_DISABLE
Dma.TIM4_UP.1.Instance=DMA1_Stream6
Dma.TIM4_UP.1.MemDataAlignment=DMA_MDATAALIGN_WORD
Dma.TIM4_UP.1.MemInc=DMA_MINC_ENABLE
Dma.TIM4_UP.1.Mode=DMA_NORMAL
Dma.TIM4_UP.1.PeriphDataAlignment=DMA_PDATAALIGN_WORD
Dma.TIM4_UP.1.PeriphInc=DMA_PINC_DISABLE
Dma.TIM4_UP.1.Priority=DMA_PRIORITY_VERY_HIGH
Mcu.Family=STM32F4
Mcu.Name=STM32F401C(B-C)Ux
Mcu.Package=UFQFPN48
NVIC.DMA1_Stream3_IRQn=true\:0\:0\:false\:false\:true\:false\:true\:true
NVIC.DMA1_Stream6_IRQn=true\:0\:0\:false\:false\:true\:false\:true\:true
NVIC.PriorityGroup=NVIC_PRIORITYGROUP_4
PA13.Mode=Serial_Wire
PA13.Signal=SYS_JTMS-SWDIO
PA14.Mode=Serial_Wire
PA14.Signal=SYS_JTCK-SWCLK
PB7.Signal=S_TIM4_CH2
PH0\ -\ OSC_IN.Mode=HSE-External-Oscillator
PH0\ -\ OSC_IN.Signal=RCC_OSC_IN
PH1\ -\ OSC_OUT.Mode=HSE-External-Oscillator
PH1\ -\ OSC_OUT.Signal=RCC_OSC_OUT
ProjectManager.HeapSize=0x200
ProjectManager.StackSize=0x400
ProjectManager.TargetToolchain=STM32CubeIDE
RCC.48MHZClocksFreq_Value=40000000
RCC.AHBFreq_Value=80000000
RCC.APB1CLKDivider=RCC_HCLK_DIV2
RCC.APB1Freq_Value=40000000
RCC.APB1TimFreq_Value=80000000
RCC.APB2Freq_Value=80000000
RCC.APB2TimFreq_Value=80000000
RCC.CortexFreq_Value=80000000
RCC.HCLKFreq_Value=80000000
RCC.HSE_VALUE=16000000
RCC.HSI_VALUE=16000000
RCC.LSE_VALUE=32768
RCC.PLLM=8
RCC.PLLN=80
RCC.PLLSourceVirtual=RCC_PLLSOURCE_HSE
RCC.SYSCLKFreq_VALUE=80000000
RCC.SYSCLKSource=RCC_SYSCLKSOURCE_PLLCLK
RCC.VCOOutputFreq_Value=160000000
SH.S_TIM4_CH2.0=TIM4_CH2,PWM Generation2 CH2
TIM1.Prescaler=79
TIM4.Channel-PWM\ Generation2\ CH2=TIM_CHANNEL_2
TIM4.Period=99
VP_TIM1_VS_ClockSourceINT.Mode=Internal
VP_TIM4_VS_ClockSourceINT.Mode=Internal
board=custom

// file: Core/Src/main.c
/* USER CODE BEGIN Header */
/**
  ******************************************************************************
  * @file           : main.c
  * @brief          : Main program body
  ******************************************************************************
  * @attention
  *
  * Copyright (c) 2024 STMicroelectronics.
  * All rights reserved.
  *
  * This software is licensed under terms that can be found in the LICENSE file
  * in the root directory of this software component.
  * If no LICENSE file comes with this software, it is provided AS-IS.
  *
  ******************************************************************************
  */
/* USER CODE END Header */
#include "main.h"
#include "dma.h"
#include "tim.h"
#include "gpio.h"

/* USER CODE BEGIN Includes */

#define NEOPIXEL_ZERO 32 //ZERO=(ARR+1)0.32
#define NEOPIXEL_ONE 64 // ONE=(ARR+1)0.64
#define NUM_PIXELS 32  //Number of LEDs  model WS2812b
#define DMA_BUFF_SIZE 769//(NUM_PIXELS*24)+1

/* USER CODE END Includes */

/* USER CODE BEGIN PTD */

 typedef union
  {
    struct
    {
      uint8_t b;
      uint8_t r;
      uint8_t g;
    } color;
    uint32_t data;
  } PixelRGB_t;

  typedef union
  {
    struct
    {
      uint8_t w;
      uint8_t b;
      uint8_t r;
      uint8_t g;
    } color;
    uint32_t data;
  }
    PixelRGBW_t;

/* USER CODE END PTD */

/* USER CODE BEGIN PD */

    PixelRGB_t pixel[NUM_PIXELS] = {0};
    uint32_t dmaBuffer[DMA_BUFF_SIZE] = {0};
    uint32_t *pBuff;
    int n, j, k;
    uint16_t stepSize;

/* USER CODE END PD */

void SystemClock_Config(void);

/* USER CODE BEGIN 0 */

void HAL_TIM_PWM_PulseFinishedCallback(TIM_HandleTypeDef *htim)
{
  HAL_TIM_PWM_Stop_DMA(htim, TIM_CHANNEL_2);
}

void RGB_Setup(){
	for (n = (NUM_PIXELS - 1); n > 0; n--)
		{
		 	  pixel[n].data = pixel[n-1].data;
		}
		 	  if (k<255)
		 	      {
		 	        pixel[0].color.g =255; //[254, 0]
		 	        pixel[0].color.r =255-k;  //[1, 255]
		 	        pixel[0].color.b =0;
		 	        j++;
		 	      }
		 	  else if (k<510){
		 		  pixel[0].color.g =255; //[254, 0]
		 		  pixel[0].color.r =0;  //[1, 255]
		 		  pixel[0].color.b =k-254;
		 		  j++;
		 	  }
		 	  else if(k<765){
		 		  pixel[0].color.g =765-k; //[254, 0]
		 		  pixel[0].color.r =0;  //[1, 255]
		 		  pixel[0].color.b =255;
		 		  j++;
		 	  }
		 	  else if(k<1020){

		 		  pixel[0].color.g =0; //[254, 0]
		 		  pixel[0].color.r =k-764;  //[1, 255]
		 		  pixel[0].color.b =255;
		 		  j++;

		 	  }
		 	  else if(k<1275){

		 	  		  pixel[0].color.g =0; //[254, 0]
		 	  		  pixel[0].color.r =255;  //[1, 255]
		 	  		  pixel[0].color.b =1275-k;
		 	  		  j++;
		 	  	  }
		 	  else if(k<1530){

		 	  	  pixel[0].color.g =k-1274; //[254, 0]
		 	  	  pixel[0].color.r =255;  //[1, 255]
		 	  	  pixel[0].color.b =0;
		 	  	  j++;
		 	  	  	  }
		 	  	    k = (k + stepSize) % 1530;
		 	  	  // not so bright
		 	  	  	pixel[0].color.g >>= 1;
		 	  	  	pixel[0].color.r >>= 1;
		 	  	  	pixel[0].color.b >>= 1;

		 	  	  pBuff = dmaBuffer;
		 	  	  	      for (n = 0; n < NUM_PIXELS; n++)
		 	  	  	      {
		 	  	  	         for (j = 23; j >= 0; j--)
		 	  	  	         {
		 	  	  	           if ((pixel[n].data >> j) & 0x01)
		 	  	  	           {
		 	  	  	             *pBuff = NEOPIXEL_ONE;
		 	  	  	           }
		 	  	  	           else
		 	  	  	           {
		 	  	  	             *pBuff = NEOPIXEL_ZERO;
		 	  	  	           }
		 	  	  	           pBuff++;
		 	  	  	       }
		 	  	  	      }
		 	  	  	     HAL_TIM_PWM_Start_DMA(&htim4, TIM_CHANNEL_2, dmaBuffer, DMA_BUFF_SIZE);

		 	  	  	      HAL_Delay(10);
}
/* USER CODE END 0 */

int main(void)
{

  /* MCU Configuration--------------------------------------------------------*/

  /* Reset of all peripherals, Initializes the Flash interface and the Systick. */
  HAL_Init();

  /* Configure the system clock */
  SystemClock_Config();

  /* Initialize all configured peripherals */
  MX_GPIO_Init();
  MX_DMA_Init();
  MX_TIM4_Init();
  MX_TIM1_Init();
  /* USER CODE BEGIN 2 */

HAL_TIM_Base_Start(&htim1);

  /* USER CODE END 2 */

  /* Infinite loop */
  /* USER CODE BEGIN WHILE */

  k = 0;
  stepSize = 4;

  while (1)
  {
    /* USER CODE END WHILE */

    /* USER CODE BEGIN 3 */

	  RGB_Setup();

  }
  /* USER CODE END 3 */
}

void SystemClock_Config(void)
{
  RCC_OscInitTypeDef RCC_OscInitStruct = {0};
  RCC_ClkInitTypeDef RCC_ClkInitStruct = {0};

  /** Configure the main internal regulator output voltage
  */
  __HAL_RCC_PWR_CLK_ENABLE();
  __HAL_PWR_VOLTAGESCALING_CONFIG(PWR_REGULATOR_VOLTAGE_SCALE2);

  /** Initializes the RCC Oscillators according to the specified parameters
  * in the RCC_OscInitTypeDef structure.
  */
  RCC_OscInitStruct.OscillatorType = RCC_OSCILLATORTYPE_HSE;
  RCC_OscInitStruct.HSEState = RCC_HSE_ON;
  RCC_OscInitStruct.PLL.PLLState = RCC_PLL_ON;
  RCC_OscInitStruct.PLL.PLLSource = RCC_PLLSOURCE_HSE;
  RCC_OscInitStruct.PLL.PLLM = 8;
  RCC_OscInitStruct.PLL.PLLN = 80;
  RCC_OscInitStruct.PLL.PLLP = RCC_PLLP_DIV2;
  RCC_OscInitStruct.PLL.PLLQ = 4;
  if (HAL_RCC_OscConfig(&RCC_OscInitStruct) != HAL_OK)
  {
    Error_Handler();
  }

  /** Initializes the CPU, AHB and APB buses clocks
  */
  RCC_ClkInitStruct.ClockType = RCC_CLOCKTYPE_HCLK|RCC_CLOCKTYPE_SYSCLK
                              |RCC_CLOCKTYPE_PCLK1|RCC_CLOCKTYPE_PCLK2;
  RCC_ClkInitStruct.SYSCLKSource = RCC_SYSCLKSOURCE_PLLCLK;
  RCC_ClkInitStruct.AHBCLKDivider = RCC_SYSCLK_DIV1;
  RCC_ClkInitStruct.APB1CLKDivider = RCC_HCLK_DIV2;
  RCC_ClkInitStruct.APB2CLKDivider = RCC_HCLK_DIV1;

  if (HAL_RCC_ClockConfig(&RCC_ClkInitStruct, FLASH_LATENCY_2) != HAL_OK)
  {
    Error_Handler();
  }
}

void Error_Handler(void)
{
  __disable_irq();
  while (1)
  {
  }
}
